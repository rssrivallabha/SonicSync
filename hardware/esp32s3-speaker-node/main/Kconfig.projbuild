## hardware/esp32s3-speaker-node/main/Kconfig.projbuild
```kconfig
menu "SonicSync Speaker Node"
config SONICSYNC_WIFI_SSID
    string "Wi-Fi SSID"
    default ""
config SONICSYNC_WIFI_PASSWORD
    string "Wi-Fi password"
    default ""
config SONICSYNC_PSK
    string "Local control PSK"
    default ""
    help
        Shared secret used to authenticate local UDP control commands.
endmenu
```

## hardware/esp32s3-speaker-node/sdkconfig.defaults
```kconfig
CONFIG_ESPTOOLPY_FLASHSIZE_8MB=y
CONFIG_PARTITION_TABLE_SINGLE_APP_LARGE=y
CONFIG_FREERTOS_HZ=1000
CONFIG_ESP_TIMER_TASK_PRIO=22
CONFIG_I2S_ENABLE_DEBUG_LOG=n
```
